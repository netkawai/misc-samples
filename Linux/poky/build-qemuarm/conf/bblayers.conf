## Linux/poky/build-qemuarm/conf/bblayers.conf
```bitbake
# POKY_BBLAYERS_CONF_VERSION is increased each time build/conf/bblayers.conf
# changes incompatibly
POKY_BBLAYERS_CONF_VERSION = "2"

BBPATH = "${TOPDIR}"
BBFILES ?= ""

BBLAYERS ?= " \
  /home/kawai/poky/meta \
  /home/kawai/poky/meta-poky \
  /home/kawai/poky/meta-yocto-bsp \
  /home/kawai/poky/meta-nova \
  "
```
